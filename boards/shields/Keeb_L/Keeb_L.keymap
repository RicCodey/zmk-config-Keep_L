#include <behaviors.dtsi>
#include <dt-bindings/zmk/keys.h>
#include <dt-bindings/zmk/bt.h>
#include <dt-bindings/zmk/outputs.h>

/ {
	keymap {
		compatible = "zmk,keymap";


		/*
		 * ========================================================
		 * L1
		 * ========================================================
		 *
		 * R1: N6 N5 N4 N3 N2 N1
		 * R2: T  R  E  W  Q  TAB
		 * R3: BSPC G  F  D  S  A  ESC
		 * R4: B  V  C  X  Z  LSHFT
		 * R5: SPACE CTRL ALT GUI
		 */

		default_layer {
			display-name = "L1";

			bindings = <
				/* R1 */
				&kp N6
				&kp N5
				&kp N4
				&kp N3
				&kp N2
				&kp N1

				/* R2 */
				&kp T
				&kp R
				&kp E
				&kp W
				&kp Q
				&kp TAB

				/* R3 */
				&kp BSPC
				&kp G
				&kp F
				&kp D
				&kp S
				&kp A
				&kp ESC

				/* R4 */
				&kp B
				&kp V
				&kp C
				&kp X
				&kp Z
				&kp LSHFT

				/* R5 */
				&kp SPACE
				&kp LCTRL
				&kp LALT
				&kp LGUI
			>;

			/* CW = Volume Down, CCW = Volume Up */
			sensor-bindings = <
				&inc_dec_kp C_VOL_DN C_VOL_UP
			>;
		};


		/*
		 * ========================================================
		 * L2
		 * ========================================================
		 *
		 * Alphabet layer.
		 *
		 * R1: A B C D E F
		 * R2: G H I J K L
		 * R3: M N O P Q R S
		 * R4: T U V W X Y
		 * R5: Z SPACE BSPC SHIFT
		 */

		layer_two {
			display-name = "L2";

			bindings = <
				/* R1 */
				&kp A
				&kp B
				&kp C
				&kp D
				&kp E
				&kp F

				/* R2 */
				&kp G
				&kp H
				&kp I
				&kp J
				&kp K
				&kp L

				/* R3 */
				&kp M
				&kp N
				&kp O
				&kp P
				&kp Q
				&kp R
				&kp S

				/* R4 */
				&kp T
				&kp U
				&kp V
				&kp W
				&kp X
				&kp Y

				/* R5 */
				&kp Z
				&kp SPACE
				&kp BSPC
				&kp LSHFT
			>;

			/* CW = Volume Down, CCW = Volume Up */
			sensor-bindings = <
				&inc_dec_kp C_VOL_DN C_VOL_UP
			>;
		};
	};
};
